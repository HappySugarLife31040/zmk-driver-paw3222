## dts/bindings/pixart,paw3222.yaml
```yaml
# Copyright 2024 Google LLC
# Copyright 2025 sekigon-gonnoc
# SPDX-License-Identifier: Apache-2.0

description: PAW32xx ultra low power wireless mouse chip

compatible: "pixart,paw3222"

include: spi-device.yaml

properties:
  irq-gpios:
    type: phandle-array
    required: true
    description:
      GPIO connected to the motion pin, active low.

  power-gpios:
    type: phandle-array
    required: false
    description:
      GPIO connected to the power control pin.

  res-cpi:
    type: int
    description: |
      CPI resolution for the sensor. This can also be changed in runtime using
      the paw32xx_set_resolution() API.

  force-awake:
    type: boolean
    description: |
      Initialize the sensor in "force awake" mode. This can also be enabled or
      disabled in runtime by the application using the paw32xx_force_awake()
      API.

   scroll-layer:
    type: int
    default: 3

  scroll-divider:
    type: int
    default: 4

scroll_layer = DT_INST_PROP_OR(n, scroll_layer, 3),
scroll_divider = DT_INST_PROP_OR(n, scroll_divider, 4),
```
